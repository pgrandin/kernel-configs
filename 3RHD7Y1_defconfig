## 3RHD7Y1_defconfig
```kconfig
CONFIG_EFI_STUB=y
CONFIG_CMDLINE_BOOL=y
CONFIG_CMDLINE="root=/dev/sda2"
CONFIG_DM_CACHE=m
CONFIG_DM_CACHE_SMQ=m
CONFIG_XFS_FS=m
```

## DC3217BY_defconfig
```kconfig
CONFIG_EFI_STUB=y
CONFIG_CMDLINE_BOOL=y
CONFIG_CMDLINE="root=/dev/sda2"
CONFIG_IWLWIFI=m
CONFIG_IWLDVM=m
```

## R630_defconfig
```kconfig
# R630
CONFIG_CMDLINE="root=PARTUUID=a8e2a688-7319-4a9a-b76c-1211198818f6"
CONFIG_DM_CACHE=m
CONFIG_DM_CACHE_SMQ=m
CONFIG_XFS_FS=m
CONFIG_BNX2=m
CONFIG_SCSI_LOWLEVEL=y
CONFIG_SCSI_MPT3SAS=y
CONFIG_MCORE2=y

# EFI
CONFIG_FRAMEBUFFER_CONSOLE=y
CONFIG_FB_EFI=y
# SAS
CONFIG_MEGARAID_SAS=y
CONFIG_IXGBE=y
# Sensors
CONFIG_SENSORS_CORETEMP=m
CONFIG_I2C_CHARDEV=m
```

## R710_defconfig
```kconfig
# R710
CONFIG_CMDLINE="root=/dev/sda2"
CONFIG_DM_CACHE=m
CONFIG_DM_CACHE_SMQ=m
CONFIG_XFS_FS=m
CONFIG_BNX2=m
CONFIG_SCSI_LOWLEVEL=y
CONFIG_SCSI_MPT3SAS=y
# Sensors
CONFIG_SENSORS_CORETEMP=m
CONFIG_I2C_CHARDEV=m
```

## XPS-9700_defconfig
```kconfig
# XPS
CONFIG_CMDLINE="root=PARTUUID=302c1a81-7e5a-4695-83cc-53006266ff27"
CONFIG_FB=y
CONFIG_FB_EFI=y
CONFIG_NVME_CORE=y
CONFIG_BLK_DEV_NVME=y
CONFIG_USB_XHCI_HCD=y
CONFIG_LOGO=n
CONFIG_WLAN_VENDOR_ADMTEK=n
CONFIG_IWLWIFI=m
CONFIG_IWLDVM=m
CONFIG_IWLMVM=m
CONFIG_FIRMWARE_IN_KERNEL=n
CONFIG_DCDBAS=m
CONFIG_FUSE_FS=m
CONFIG_SND_USB_AUDIO=m
CONFIG_THUNDERBOLT=m
CONFIG_INTEL_WMI_THUNDERBOLT=m
CONFIG_ACPI_WMI=m
CONFIG_SND_HDA_INTEL=m
CONFIG_SOUND=m
CONFIG_SND_HDA_CODEC_REALTEK=m
CONFIG_SND_HDA_CODEC_HDMI=m
CONFIG_SND_DYNAMIC_MINORS=y
CONFIG_HOTPLUG_PCI_PCIE=y
CONFIG_HOTPLUG_PCI_ACPI=y
CONFIG_E1000E=m

# Dell
CONFIG_X86_PLATFORM_DRIVERS_DELL=y
CONFIG_DELL_SMBIOS=m
CONFIG_DELL_SMBIOS_WMI=y
CONFIG_DELL_SMBIOS_SMM=y

# WIFI
CONFIG_CRYPTO_MICHAEL_MIC=y
CONFIG_ATH11K=m
CONFIG_ATH11K_PCI=m

CONFIG_MEDIA_SUPPORT=m
CONFIG_MEDIA_USB_SUPPORT=y
CONFIG_MEDIA_CAMERA_SUPPORT=y
CONFIG_VIDEO_V4L2=m
CONFIG_USB_GSPCA=m
CONFIG_USB_GSPCA_SUNPLUS=m
CONFIG_USB_VIDEO_CLASS=m

CONFIG_MFD_RTSX_PCI=m

CONFIG_I2C_CHARDEV=m
CONFIG_DRM_I915=m

# Bluetooth
CONFIG_EXTRA_FIRMWARE="qca/htbtfw20.tlv qca/htnv20.bin"
CONFIG_EXTRA_FIRMWARE_DIR="/lib/firmware"
CONFIG_BT=m
CONFIG_BT_HCIBTUSB=m

# bluetooth over ath11k
CONFIG_BT_HCIUART_SERDEV=y
CONFIG_BT_QCA=m
CONFIG_BT_HCIUART=m
CONFIG_BT_HCIUART_QCA=y
CONFIG_SERIAL_DEV_BUS=y
CONFIG_SERIAL_8250_DW=y


CONFIG_BLK_DEV_NBD=m

CONFIG_INTEL_IOMMU_DEFAULT_ON=y
CONFIG_IOMMU_DEFAULT_PASSTHROUGH=y

CONFIG_CPU_FREQ_STAT=y
CONFIG_INTEL_IOMMU_SVM=y
CONFIG_IRQ_REMAP=y

# Misc
CONFIG_LPC_ICH=y
CONFIG_X86_INTEL_LPSS=y
CONFIG_MFD_INTEL_LPSS_ACPI=y
CONFIG_MFD_INTEL_LPSS_PCI=y
CONFIG_GPIO_ICH=y
CONFIG_GPIOLIB=y
CONFIG_MFD_INTEL_QUARK_I2C_GPIO=y
CONFIG_PINCTRL_CANNONLAKE=y
CONFIG_USB4=y
CONFIG_I2C_GPIO=m
CONFIG_I2C_HID_ACPI=m
CONFIG_USB_UAS=m
CONFIG_I2C_NVIDIA_GPU=m

# Sensors
CONFIG_SENSORS_CORETEMP=m
```

## bluez_defconfig
```kconfig
CONFIG_BT_BNEP=m
CONFIG_BT_BNEP_MC_FILTER=y
CONFIG_BT_BNEP_PROTO_FILTER=y
CONFIG_CRYPTO_USER_API_HASH=m
CONFIG_CRYPTO_USER_API_SKCIPHER=m
CONFIG_UHID=m
CONFIG_CRYPTO_USER=m
CONFIG_CRYPTO_USER_API=m
CONFIG_CRYPTO_USER_API_AEAD=m
CONFIG_CRYPTO_SHA1=m
```

## common_defconfig
```kconfig
# common
CONFIG_KEY_DH_OPERATIONS=y
CONFIG_CMDLINE_BOOL=y

# stuff we don't want
CONFIG_FDDI=n
CONFIG_MACINTOSH_DRIVERS=n
CONFIG_USB_PRINTER=n
CONFIG_WLAN_VENDOR_ADMTEK=n

# useful gadgets
CONFIG_USB_SERIAL=m
CONFIG_USB_SERIAL_FTDI_SIO=m
CONFIG_USB_SERIAL_CP210X=m
CONFIG_USB_ACM=m
CONFIG_USB_RTL8152=m
CONFIG_USB_IPHETH=m
CONFIG_USB_SERIAL_PL2303=m
CONFIG_USB_SERIAL_CH341=m

# Misc
CONFIG_REISERFS_FS=m
```

## docker_defconfig
```kconfig
CONFIG_CGROUP_DEVICE=y
CONFIG_MEMCG=y
CONFIG_VETH=m
CONFIG_BRIDGE=m
CONFIG_NETFILTER_ADVANCED=y
CONFIG_BRIDGE_NETFILTER=m
CONFIG_USER_NS=y
CONFIG_CGROUP_PIDS=y
CONFIG_MEMCG_SWAP=y
CONFIG_MEMCG_SWAP_ENABLED=y
CONFIG_BLK_CGROUP=y
CONFIG_BLK_DEV_THROTTLING=y
CONFIG_CFQ_GROUP_IOSCHED=y
CONFIG_CGROUP_PERF=y
CONFIG_CGROUP_HUGETLB=y
CONFIG_NET_CLS_CGROUP=y
CONFIG_CFS_BANDWIDTH=y
CONFIG_RT_GROUP_SCHED=y
CONFIG_IP_VS=m
CONFIG_IP_VS_PROTO_TCP=y
CONFIG_IP_VS_PROTO_UDP=y
CONFIG_IP_VS_NFCT=y
CONFIG_IP_VS_RR=m
CONFIG_VXLAN=m
CONFIG_NET_L3_MASTER_DEV=y
CONFIG_IPVLAN=m
CONFIG_MACVLAN=m
CONFIG_DUMMY=m
CONFIG_CGROUP_NET_PRIO=y
CONFIG_DM_THIN_PROVISIONING=m
CONFIG_NF_NAT_IPV4=m
CONFIG_IP_NF_NAT=m
CONFIG_IP_NF_TARGET_MASQUERADE=m
CONFIG_NETFILTER_XT_MATCH_ADDRTYPE=m
CONFIG_NF_NAT=m
CONFIG_NF_NAT_NEEDED=y
CONFIG_IP_NF_TARGET_MASQUERADE=m
CONFIG_VHOST_NET=m
CONFIG_KVM=m
CONFIG_KVM_INTEL=m
CONFIG_VFIO=m
CONFIG_VFIO_PCI=m
CONFIG_VFIO_VIRQFD=m
```

## gvt_defconfig
```kconfig
# gvt
CONFIG_DRM_I915_GVT=y
CONFIG_DRM_I915_GVT_KVMGT=m
CONFIG_VFIO_MDEV=m
CONFIG_VFIO_MDEV_DEVICE=m
```

## kvm_defconfig
```kconfig
# kvm
CONFIG_KVM=m
CONFIG_KVM_INTEL=m
CONFIG_VIRTIO_PCI=y
CONFIG_VIRTIO_NET=y
CONFIG_VIRTIO_BLK=y
CONFIG_DRM_VIRTIO_GPU=y
CONFIG_TUN=m
```

## libvirt_defconfig
```kconfig
# libvirt
CONFIG_BRIDGE_EBT_MARK_T=m
CONFIG_BRIDGE_NF_EBTABLES=m
CONFIG_NETFILTER_XT_CONNMARK=m
CONFIG_NETFILTER_XT_MARK=m
CONFIG_NETFILTER_XT_TARGET_CHECKSUM=m
CONFIG_IP6_NF_NAT=m
CONFIG_BRIDGE_EBT_T_NAT=m
CONFIG_NET_ACT_POLICE=m
CONFIG_NET_CLS_FW=m
CONFIG_NET_CLS_U32=m
CONFIG_NET_SCH_HTB=m
CONFIG_NET_SCH_INGRESS=m
CONFIG_NET_SCH_SFQ=m
CONFIG_MACVTAP=m
CONFIG_TAP=m
CONFIG_NETFILTER_ADVANCED=y
CONFIG_NETFILTER_XT_CONNMARK=m
CONFIG_NETFILTER_XT_TARGET_CHECKSUM=m
CONFIG_IP6_NF_NAT=m
```

## precision_defconfig
```kconfig
CONFIG_CMDLINE="root=/dev/nvme0n1p5 i915.enable_gvt=1"
CONFIG_NVME_CORE=y
CONFIG_BLK_DEV_NVME=y
CONFIG_MACINTOSH_DRIVERS=n
CONFIG_USB_XHCI_HCD=y
CONFIG_LOGO=n
CONFIG_FDDI=n
CONFIG_WLAN_VENDOR_ADMTEK=n
CONFIG_IWLWIFI=m
CONFIG_IWLDVM=m
CONFIG_IWLMVM=m
CONFIG_ETHERNET=n
CONFIG_FIRMWARE_IN_KERNEL=n
CONFIG_DCDBAS=m
CONFIG_USB_PRINTER=n
CONFIG_FUSE_FS=m
CONFIG_SND_USB_AUDIO=m
CONFIG_THUNDERBOLT=m
CONFIG_INTEL_WMI_THUNDERBOLT=m
CONFIG_ACPI_WMI=m
CONFIG_SND_HDA_INTEL=m
CONFIG_SOUND=m
CONFIG_SND_HDA_CODEC_REALTEK=m
CONFIG_SND_HDA_CODEC_HDMI=m
CONFIG_SND_DYNAMIC_MINORS=y
CONFIG_HOTPLUG_PCI_PCIE=y
CONFIG_HOTPLUG_PCI_ACPI=y

# VPN
CONFIG_TUN=m

CONFIG_MEDIA_SUPPORT=m
CONFIG_MEDIA_USB_SUPPORT=y
CONFIG_MEDIA_CAMERA_SUPPORT=y
CONFIG_VIDEO_V4L2=m
CONFIG_USB_GSPCA=m
CONFIG_USB_GSPCA_SUNPLUS=m
CONFIG_USB_VIDEO_CLASS=m

CONFIG_MFD_RTSX_PCI=m

CONFIG_I2C_CHARDEV=m
# TMP
# CONFIG_FB_INTEL_I2C=y
# CONFIG_EXPERT=y
# CONFIG_FB_INTEL=m
CONFIG_DRM_I915=m

CONFIG_BT=m
CONFIG_BT_HCIBTUSB=m
CONFIG_BT_RFCOMM=m
CONFIG_BT_RFCOMM_TTY=y

CONFIG_HID_MAGICMOUSE=m
CONFIG_BT_HIDP=m

CONFIG_USB_SERIAL=m
CONFIG_USB_SERIAL_FTDI_SIO=m
CONFIG_USB_SERIAL_CP210X=m
CONFIG_USB_ACM=m
CONFIG_USB_RTL8152=m

CONFIG_REISERFS_FS=m

CONFIG_BLK_DEV_NBD=m

CONFIG_INTEL_IOMMU_DEFAULT_ON=y

CONFIG_USB_IPHETH=m
CONFIG_CPU_FREQ_STAT=y
```
